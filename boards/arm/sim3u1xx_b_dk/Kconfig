## boards/arm/sim3u1xx_b_dk/Kconfig
```kconfig
# Kconfig - SIM3U1XX-B-DK board configuration
#
# Copyright (c) 2019 Christian Taedcke
#
# SPDX-License-Identifier: Apache-2.0

if BOARD_SIM3U1XX_B_DK

config BOARD_INIT_PRIORITY
	int

	# omit prompt to signify a "hidden" option
	default KERNEL_INIT_PRIORITY_DEFAULT
	depends on GPIO
	help
	  Board initialization priority. This must be bigger than
	  GPIO_SIM3_COMMON_INIT_PRIORITY.

endif # BOARD_SIM3U1XX_B_DK
```

## boards/arm/sim3u1xx_b_dk/Kconfig.board
```kconfig
# Kconfig - SIM3U1XX-B-DK board
#
# Copyright (c) 2019, Christian Taedcke
#
# SPDX-License-Identifier: Apache-2.0
#

config BOARD_SIM3U1XX_B_DK
	bool "SiLabs SIM3U1XX-B-DK"
	depends on SOC_SERIES_SIM3U
	select SOC_PART_NUMBER_SIM3U167_A_GM
```

## boards/arm/sim3u1xx_b_dk/Kconfig.defconfig
```kconfig
# Kconfig - SIM3U1XX-B-DK board
#
# Copyright (c) 2019, Christian Taedcke
#
# SPDX-License-Identifier: Apache-2.0
#

if BOARD_SIM3U1XX_B_DK

config BOARD
	default "sim3u1xx_b_dk"

if GPIO_SIM3

config GPIO_SIM3_PORT2
	default y

endif # GPIO_SIM3

if UART_SIM3

config UART_SIM3_0
	default y

endif # UART_SIM3

endif # BOARD_SIM3U1XX_B_DK
```

## boards/arm/sim3u1xx_b_dk/sim3u1xx_b_dk_defconfig
```kconfig
CONFIG_ARM=y
CONFIG_SOC_FAMILY_SIM3=y
CONFIG_SOC_SERIES_SIM3U=y
CONFIG_BOARD_SIM3U1XX_B_DK=y
CONFIG_CONSOLE=y
CONFIG_UART_CONSOLE=y
CONFIG_SERIAL=y
CONFIG_CORTEX_M_SYSTICK=y
CONFIG_GPIO=y
CONFIG_SYS_CLOCK_HW_CYCLES_PER_SEC=48000000
```

## drivers/flash/Kconfig.sim3
```kconfig
# Kconfig - Silicon Labs Sim3 flash driver config
#
# Copyright (c) 2019, Christian Taedcke
#
# SPDX-License-Identifier: Apache-2.0

config SOC_FLASH_SIM3
	bool "Silicon Labs Sim3 flash driver"
	depends on FLASH && SOC_FAMILY_SIM3
	select FLASH_HAS_DRIVER_ENABLED
	help
	  Enable Silicon Labs Sim3 series internal flash driver.

if SOC_FLASH_SIM3

endif # SOC_FLASH_SIM3
```

## drivers/gpio/Kconfig.sim3
```kconfig
# Kconfig.sim3 - Sim3 GPIO configuration options
#
# Copyright (c) 2019 Christian Taedcke
#
# SPDX-License-Identifier: Apache-2.0
#

menuconfig GPIO_SIM3
	bool "Sim3 GPIO driver"
	depends on GPIO && SOC_FAMILY_SIM3
	select HAS_DTS_GPIO
	help
	  Enable the Gecko gpio driver.

if GPIO_SIM3

config GPIO_SIM3_COMMON_INIT_PRIORITY
	int "Common initialization priority"
	default 39

config GPIO_SIM3_PORT0
	bool "Port 0"
	help
	  Enable Port Bank PB0.

config GPIO_SIM3_PORT1
	bool "Port 1"
	help
	  Enable Port Bank PB1.

config GPIO_SIM3_PORT2
	bool "Port 2"
	help
	  Enable Port Bank PB2.

config GPIO_SIM3_PORT3
	bool "Port 3"
	help
	  Enable Port Bank PB3.

config GPIO_SIM3_PORT4
	bool "Port 4"
	help
	  Enable Port Bank PB4.

endif # GPIO_SIM3
```

## drivers/serial/Kconfig.sim3
```kconfig
# Kconfig - Sim3 UART
#
# Copyright (c) 2019, Christian Taedcke
#
# SPDX-License-Identifier: Apache-2.0
#

menuconfig UART_SIM3
	bool "Sim3 UART/USART driver"
	depends on SOC_FAMILY_SIM3
	depends on GPIO_SIM3
	select SERIAL_HAS_DRIVER
	select SERIAL_SUPPORT_INTERRUPT
	select SOC_SIM3_USART
	help
	  Enable the Sim3 uart driver.

if UART_SIM3

config UART_SIM3_0
	bool "Enable Sim3 UART 0"
	help
	  Enable support for Sim3 UART0 port in the driver. Say y here if you
	  want to use UART0 device.

config UART_SIM3_1
	bool "Enable Sim3 UART 1"
	help
	  Enable support for Sim3 UART1 port in the driver. Say y here if you
	  want to use UART1 device.

config USART_SIM3_0
	bool "Enable Sim3 USART 0"
	help
	  Enable support for Sim3 USART0 port in the driver. Say y here if you
	  want to use USART0 device.

config USART_SIM3_1
	bool "Enable Sim3 USART 1"
	help
	  Enable support for Sim3 USART1 port in the driver. Say y here if you
	  want to use USART1 device.

endif # UART_SIM3
```

## dts/bindings/gpio/silabs,sim3-gpio-port.yaml
```yaml
---
title: SIM3 GPIO
version: 0.1

description: >
    This is a representation of the SIM3 GPIO Port nodes

properties:
    compatible:
      type: string
      category: required
      description: compatible strings
      constraint: "silabs,sim3-gpio-port"
      generation: define

    reg:
      type: int
      description: mmio register space
      generation: define
      category: required

    label:
      type: string
      category: required
      description: Human readable string describing the device (used by Zephyr for API name)
      generation: define

"#cells":
  - pin
  - flags
...
```

## dts/bindings/gpio/silabs,sim3-gpio.yaml
```yaml
---
title: SIM3 GPIO
version: 0.1

description: >
    This is a representation of the SIM3 GPIO nodes

properties:
    compatible:
      type: string
      category: required
      description: compatible strings
      constraint: "silabs,sim3-gpio"
      generation: define

    reg:
      type: int
      description: mmio register space
      generation: define
      category: required

    interrupts:
      type: compound
      category: required
      description: required interrupts
      generation: define

    label:
      type: string
      category: required
      description: Human readable string describing the device (used by Zephyr for API name)
      generation: define

...
```

## dts/bindings/serial/silabs,sim3-uart.yaml
```yaml
---
title: SIM3 UART
version: 0.1

description: >
    This binding gives a base representation of the SIM3 UART

inherits:
    !include uart.yaml

properties:
    compatible:
      constraint: "silabs,sim3-uart"

    reg:
      type: array
      description: mmio register space
      generation: define
      category: required

    interrupts:
      type: compound
      category: required
      description: required interrupts
      generation: define

...
```

## soc/arm/silabs_sim3/Kconfig
```kconfig
#
# Copyright (c) 2019 Christian Taedcke
#
# SPDX-License-Identifier: Apache-2.0
#

config SOC_FAMILY_SIM3
	bool
	# omit prompt to signify a "hidden" option

if SOC_FAMILY_SIM3
config SOC_FAMILY
	string
	default "silabs_sim3"

source "soc/arm/silabs_sim3/*/Kconfig.soc"

config SOC_PART_NUMBER
	string
	help
	  This string holds the full part number of the SoC. It is a hidden option
	  that you should not set directly. The part number selection choice defines
	  the default value for this string.

endif # SOC_FAMILY_SIM3
```

## soc/arm/silabs_sim3/Kconfig.soc
```kconfig
#
# Copyright (c) 2019 Christian Taedcke
#
# SPDX-License-Identifier: Apache-2.0
#

source "soc/arm/silabs_sim3/*/Kconfig.series"
```

## soc/arm/silabs_sim3/sim3u/Kconfig.defconfig.sim3u
```kconfig
# Kconfig - Silicon Labs SIM3U configuration options

#
# Copyright (c) 2019 Christian Taedcke
#
# SPDX-License-Identifier: Apache-2.0
#

if SOC_SERIES_SIM3U

if GPIO

config GPIO_SIM3
	default y

endif # GPIO

if SERIAL

config UART_SIM3
	default y

endif # SERIAL

if FLASH

config SOC_FLASH_SIM3
	default y

endif # FLASH

endif # SOC_SERIES_SIM3U
```

## soc/arm/silabs_sim3/sim3u/Kconfig.series
```kconfig
# Kconfig - SIM3U MCU line
#
# Copyright (c) 2017 Christian Taedcke
#
# SPDX-License-Identifier: Apache-2.0
#

config SOC_SERIES_SIM3U
	bool "SIM3U Series MCU"
	select CPU_CORTEX_M3
	select SOC_FAMILY_SIM3
	select SYS_POWER_LOW_POWER_STATE_SUPPORTED
	select CPU_HAS_SYSTICK
	select SOC_SIM3U_GPIO
	help
	  Enable support for SiM3U MCU series
```

## soc/arm/silabs_sim3/sim3u/Kconfig.soc
```kconfig
# Kconfig - SIM3U MCU line
#
# Copyright (c) 2019 Christian Taedcke
#
# SPDX-License-Identifier: Apache-2.0
#

if SOC_SERIES_SIM3U

config SOC_PART_NUMBER_SIM3U167AGM
	bool

endif # SOC_SERIES_SIM3U
```
